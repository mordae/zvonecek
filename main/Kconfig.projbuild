## main/Kconfig.projbuild
```kconfig
menu "Zvonecek"
	config IDLE_TIMEOUT
		int "Idle timeout (seconds)"
		default 900
		range 10 3600

	config IDLE_REPEAT
		int "Idle repeat timeout (seconds)"
		default 60
		range 10 3600

	config SAMPLE_FREQ
		int "Sampling frequency"
		default 48000
		range 44100 96000

	menu "GPIO Mapping"
		config LED_GPIO
			int "WS2812 pin"
			default 16
			range 0 46

		config VOLUME_GPIO
			int "Volume switch pin"
			default 18
			range 0 46

		config ROW1_GPIO
			int "Keyboard row 1 pin"
			default 26
			range 0 46

		config ROW2_GPIO
			int "Keyboard row 2 pin"
			default 4
			range 0 46

		config ROW3_GPIO
			int "Keyboard row 3 pin"
			default 17
			range 0 46

		config KEY1_GPIO
			int "Keyboard key 1 pin"
			default 27
			range 0 46

		config KEY2_GPIO
			int "Keyboard key 2 pin"
			default 14
			range 0 46

		config KEY3_GPIO
			int "Keyboard key 3 pin"
			default 12
			range 0 46

		config KEY4_GPIO
			int "Keyboard key 4 pin"
			default 13
			range 0 46

		config KEY5_GPIO
			int "Keyboard key 5 pin"
			default 15
			range 0 46

		config KEY6_GPIO
			int "Keyboard key 6 pin"
			default 2
			range 0 46
	endmenu
endmenu
```

## sdkconfig.defaults
```kconfig
CONFIG_FREERTOS_HZ=1000
CONFIG_ESPTOOLPY_FLASHSIZE_4MB=y
CONFIG_ESPTOOLPY_FLASHSIZE="4MB"

CONFIG_ESP_DEFAULT_CPU_FREQ_MHZ_240=y
CONFIG_ESP_DEFAULT_CPU_FREQ_MHZ=240

CONFIG_FREERTOS_USE_TICKLESS_IDLE=y
CONFIG_PM_ENABLE=y

CONFIG_PARTITION_TABLE_CUSTOM=y
CONFIG_PARTITION_TABLE_CUSTOM_FILENAME="partitions.csv"
CONFIG_PARTITION_TABLE_FILENAME="partitions.csv"
```
